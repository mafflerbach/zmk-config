## config/boards/shields/holymoly/Kconfig.defconfig
```kconfig
# Copyright (c) 2020 The ZMK Contributors
# SPDX-License-Identifier: MIT

if SHIELD_HOLYMOLY_LEFT

config ZMK_KEYBOARD_NAME
    default "holymoly"

config ZMK_SPLIT_BLE_ROLE_CENTRAL
    default y

endif

if SHIELD_HOLYMOLY_LEFT || SHIELD_HOLYMOLY_RIGHT

config ZMK_SPLIT
    default y

endif
```

## config/boards/shields/holymoly/Kconfig.shield
```kconfig
# Copyright (c) 2020 The ZMK Contributors
# SPDX-License-Identifier: MIT

config SHIELD_HOLYMOLY_LEFT
    def_bool $(shields_list_contains,holymoly_left)

config SHIELD_HOLYMOLY_RIGHT
    def_bool $(shields_list_contains,holymoly_right)
```
